## conf/bblayers.conf.sample
```bitbake
# POKY_BBLAYERS_CONF_VERSION is increased each time build/conf/bblayers.conf
# changes incompatibly
POKY_BBLAYERS_CONF_VERSION = "2"

BBPATH = "${TOPDIR}"
BBFILES ?= ""

BBLAYERS ?= " \
  /home/vivakin/projects/tools/yocto/poky/meta \
  /home/vivakin/projects/tools/yocto/poky/meta-poky \
  /home/vivakin/projects/tools/yocto/poky/meta-yocto-bsp \
  /home/vivakin/projects/htpc/meta-htpc \
  /home/vivakin/projects/htpc/meta-ion330 \
  /home/vivakin/projects/tools/yocto/meta-intel \
  /home/vivakin/projects/tools/yocto/meta-openembedded/meta-oe \
  /home/vivakin/projects/tools/yocto/meta-openembedded/meta-multimedia \
  "
```

## conf/distro/tvz.conf
```bitbake
DISTRO = "tvz"
DISTRO_NAME = "TeleViZor Linux"
DISTRO_VERSION = "0.2"
# Бог молитвы в славянской мифологии
DISTRO_CODENAME = "Barma"
SDK_VENDOR = "-tvzsdk"
SDK_VERSION := "${@'${DISTRO_VERSION}'.replace('snapshot-${DATE}','snapshot')}"

MAINTAINER = "Vladimir Ivakin <vladimir_iva@pisem.net>"

TARGET_VENDOR = "-tvz"

TVZ_DEFAULT_DISTRO_FEATURES = "largefile systemd nls opengl kodi"
TVZ_DEFAULT_EXTRA_RDEPENDS = "packagegroup-core-boot"
TVZ_DEFAULT_EXTRA_RRECOMENDS = ""

DISTRO_FEATURES ?= "${DISTRO_FEATURES_DEFAULT} ${DISTRO_FEATURES_LIBC} ${TVZ_DEFAULT_DISTRO_FEATURES}"
DISTRO_FEATURES_remove = "3g bluetooth nfc wifi irda pcmcia usbgadget zeroconf pulseaudio bluez5 gobject-introspection-data"
DISTRO_FEATURES_BACKFILL_CONSIDERED = "sysvinit"

VIRTUAL-RUNTIME_init_manager = "systemd"
VIRTUAL-RUNTIME_initscripts = ""

SDK_NAME = "${DISTRO}-${TCLIBC}-${SDK_ARCH}-${IMAGE_BASENAME}-${TUNE_PKGARCH}"
SDKPATH = "/opt/${DISTRO}/${SDK_VERSION}"

DISTRO_EXTRA_RDEPENDS += " ${TVZ_DEFAULT_EXTRA_RDEPENDS}"
#DISTRO_EXTRA_RRECOMMENDS += " ${TVZ_DEFAULT_EXTRA_RRECOMMENDS}"

TCLIBCAPPEND = ""

BB_SIGNATURE_HANDLER ?= "OEBasicHash"

# QA check settings - a little stricter than the OE-Core defaults
WARN_QA = "textrel files-invalid incompatible-license xorg-driver-abi libdir \
           unknown-configure-option build-deps"
ERROR_QA = "dev-so debug-deps dev-deps debug-files arch pkgconfig la perms \
            useless-rpaths rpaths staticdev ldflags pkgvarcheck already-stripped \
            compile-host-path dep-cmp installed-vs-shipped install-host-path \
            packages-list perm-config perm-line perm-link pkgv-undefined \
            pn-overrides split-strip var-undefined version-going-backwards"
PREFERRED_PROVIDER_ffmpeg = "ffmpeg"
```

## conf/layer.conf
```bitbake
# We have a conf and classes directory, add to BBPATH
BBPATH .= ":${LAYERDIR}"

# We have recipes-* directories, add to BBFILES
BBFILES += "${LAYERDIR}/recipes-*/*/*.bb ${LAYERDIR}/recipes-*/*/*.bbappend"

BBFILE_COLLECTIONS += "htpc"
BBFILE_PATTERN_htpc = "^${LAYERDIR}/"
BBFILE_PRIORITY_htpc = "6"

# This should only be incremented on significant changes that will
# cause compatibility issues with other layers
LAYERVERSION_htpc = "1"

LAYERDEPENDS_htpc = "core"
```
